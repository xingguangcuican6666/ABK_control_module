## files/drivers/abk_control/Kconfig
```kconfig
# SPDX-License-Identifier: GPL-2.0
config ABK_CONTROL
	bool "ABK control interface"
	help
	  Provide a small in-kernel registration API for ABK external modules
	  that expose runtime control hooks.

	  Runtime status returns ABK external module metadata collected at build
	  time. Commands such as "disable <id>" or "enable <id>" call the matching
	  registered control callback when one exists.
```
